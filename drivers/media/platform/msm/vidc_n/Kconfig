## drivers/media/platform/msm/vidc_n/Kconfig
```kconfig
#
# VIDEO CORE
#

menuconfig MSM_VIDC_V4L2_N
	bool "Qualcomm MSM V4L2 based video driver Nougat"
		depends on ARCH_MSM && VIDEO_V4L2
		select VIDEOBUF2_CORE

source "drivers/media/platform/msm/vidc_n/vmem/Kconfig"
source "drivers/media/platform/msm/vidc_n/governors/Kconfig"
```
